## conf/layer.conf
```bitbake
# We have a conf directory, append to BBPATH
BBPATH .= ":${LAYERDIR}"

# We have a recipes directory, add to BBFILES
BBFILES += "${LAYERDIR}/recipes*/*/*.bb ${LAYERDIR}/recipes*/*/*.bbappend"

BBFILE_COLLECTIONS += "grinn-layer"
BBFILE_PATTERN_grinn-layer := "^${LAYERDIR}/"
BBFILE_PRIORITY_grinn-layer = "8"
```

## conf/machine/chiliboard.conf
```bitbake
#@TYPE: Machine
#@NAME: Grinn chiliboard machine
#@DESCRIPTION: Machine configuration for chiliboard

PREFERRED_PROVIDER_virtual/xserver = "xserver-xorg"
XSERVER = "xserver-xorg \
           xf86-input-evdev \
           xf86-video-fbdev"

# Only has DVI connector for external screen
GUI_MACHINE_CLASS = "bigscreen"

require conf/machine/include/ti33x.inc
EXTRA_IMAGEDEPENDS = "u-boot-denx"

PREFERRED_PROVIDER_virtual/kernel = "linux-chiliboard"
PREFERRED_PROVIDER_virtual/bootloader = "u-boot-denx"

PREFFERED_PROVIDER_ntpdate = "ntp"

#IMAGE_FSTYPES += "tar.bz2 "

SERIAL_CONSOLE = "115200 ttyO0"

UBOOT_MACHINE = "chilisom_gcs2_config"

MACHINE_FEATURES = "kernel26 screen apm usbgadget usbhost vfat alsa"
```

## conf/machine/hmi_gcs2.conf
```bitbake
#@TYPE: Machine
#@NAME: Grinn HMI GCS2 machine
#@DESCRIPTION: Machine configuration for HMI GCS2

PREFERRED_PROVIDER_virtual/xserver = "xserver-xorg"
XSERVER = "xserver-xorg \
           xf86-input-evdev \
           xf86-video-fbdev"

# Only has DVI connector for external screen
GUI_MACHINE_CLASS = "bigscreen"

require conf/machine/include/ti33x.inc
EXTRA_IMAGEDEPENDS = "u-boot-denx"

PREFERRED_PROVIDER_virtual/kernel = "linux-hmi"
PREFERRED_PROVIDER_virtual/bootloader = "u-boot-denx"

PREFFERED_PROVIDER_ntpdate = "ntp"

#IMAGE_FSTYPES += "tar.bz2 "

SERIAL_CONSOLE = "115200 ttyO0"

UBOOT_MACHINE = "chilisom_gcs2_config"

MACHINE_FEATURES = "kernel26 screen apm usbgadget usbhost vfat alsa"
```

## recipes-kernel/linux/linux-chilisom-evb-lite-3.2/chilisom-evb-lite/Kconfig.patch
```kconfig
--- linux-orig/arch/arm/mach-omap2/Kconfig	2012-09-21 09:52:48.547686117 +0200
+++ linux-cwt/arch/arm/mach-omap2/Kconfig	2012-10-10 14:19:13.325773794 +0200
@@ -337,6 +337,11 @@ config MACH_AM335XEVM
 	depends on SOC_OMAPAM33XX
 	default y
 
+config AM335XEVM_UART
+	bool "AM335X Evaluation Module set pinmux for all UARTs"
+	depends on MACH_AM335XEVM
+	default n
+
 config MACH_AM335XIAEVM
 	bool "AM335X IA Evaluation Module"
 	depends on SOC_OMAPAM33XX
```
